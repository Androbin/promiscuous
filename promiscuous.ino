#include <ESP8266WiFi.h>

static const uint8_t CRC_TABLE[] PROGMEM = {
  0x00, 0x5e, 0xbc, 0xe2, 0x61, 0x3f, 0xdd, 0x83, 0xc2, 0x9c, 0x7e, 0x20, 0xa3, 0xfd, 0x1f, 0x41,
  0x9d, 0xc3, 0x21, 0x7f, 0xfc, 0xa2, 0x40, 0x1e, 0x5f, 0x01, 0xe3, 0xbd, 0x3e, 0x60, 0x82, 0xdc,
  0x23, 0x7d, 0x9f, 0xc1, 0x42, 0x1c, 0xfe, 0xa0, 0xe1, 0xbf, 0x5d, 0x03, 0x80, 0xde, 0x3c, 0x62,
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  0x74, 0x2a, 0xc8, 0x96, 0x15, 0x4b, 0xa9, 0xf7, 0xb6, 0xe8, 0x0a, 0x54, 0xd7, 0x89, 0x6b, 0x35,
};

const uint8_t broadcast[6] = {0xff, 0xff, 0xff, 0xff, 0xff, 0xff};

struct Packet {
  uint8_t x[16];
  uint8_t target[6];
  uint8_t y[6];
  uint8_t originA[6];
  uint8_t z[16];
  uint16_t length;
  uint16_t seq;
  uint8_t originB[6];
};

struct DataBuffer {
  uint8_t nonzero;
  char ssid[32];
  char pass[64];
};

uint8_t origin[6] = {0xff, 0xff, 0xff, 0xff, 0xff, 0xff};

uint8_t guide;
boolean guided;

uint16_t lastLength;
uint16_t refLength;

uint16_t lengthX;
uint16_t lengthY;

DataBuffer dataBuffer;
uint8_t nonzero;

uint8 channel = 1;
unsigned int nothing_new = 0;

void promiscuous_cb(uint8_t *buffer, uint16_t bufferLength);

void setup() {
  Serial.begin(115200);
  Serial.println();
  Serial.println();

  wifi_set_opmode(STATION_MODE);
  wifi_set_sleep_type(NONE_SLEEP_T);
  wifi_set_channel(channel);
  wifi_promiscuous_enable(0);
  wifi_set_promiscuous_rx_cb(promiscuous_cb);
  wifi_promiscuous_enable(1);

  reset(true);
}

void loop() {
  nothing_new++;

  if (nothing_new > 200) {
    nothing_new = 0;
    channel = channel % 13 + 1;
    // wifi_set_channel(channel);
  }

  delay(1);
}

boolean cmpMac(const uint8_t a[6], const uint8_t b[6]) {
  for (size_t i = 0; i < 6; i++) {
    if (a[i] != b[i]) {
      return false;
    }
  }

  return true;
}

boolean copyMac(uint8_t d[6], const uint8_t s[6]) {
  for (size_t i = 0; i < 6; i++) {
    d[i] = s[i];
  }
}

void reset(boolean all) {
  lengthX = 0;
  lengthY = 0;

  uint8_t* dataBufferRaw = reinterpret_cast<uint8_t*>(&dataBuffer);

  for (size_t i = 0; i < sizeof(DataBuffer); i++) {
    dataBufferRaw[i] = 0;
  }

  nonzero = 0;

  if (!all) {
    return;
  }

  guide = 0;
  guided = false;

  lastLength = 0;
  refLength = 0;
}

void ICACHE_RAM_ATTR handleUdpData(uint16_t x, uint16_t y, uint16_t z) {
  uint8_t* dataBufferRaw = reinterpret_cast<uint8_t*>(&dataBuffer);

  const uint8_t crc = (x & 0xf0) | ((z & 0xf0) >> 4);
  const uint8_t seq = y & 0xff;
  const uint8_t data = ((x & 0x0f) << 4) | (z & 0x0f);

  const uint8_t xcrc = pgm_read_byte(&CRC_TABLE[pgm_read_byte(&CRC_TABLE[data]) ^ seq]);

  if (crc != xcrc) {
    return;
  }

  if (seq >= sizeof(DataBuffer) || data == 0) {
    return;
  }

  if (dataBufferRaw[seq] != 0) {
    return;
  }

  dataBufferRaw[seq] = data;
  nonzero++;

  if (nonzero != dataBuffer.nonzero) {
    return;
  }

  Serial.print(F("ssid: "));
  Serial.println(dataBuffer.ssid);
  Serial.print(F("pass: "));
  Serial.println(dataBuffer.pass);
}

void ICACHE_RAM_ATTR promiscuous_cb(uint8_t *buffer, uint16_t bufferLength) {
  if (bufferLength != sizeof(Packet)) {
    return;
  }

  Packet *packet = reinterpret_cast<struct Packet*>(buffer);

  if (!cmpMac(packet->target, broadcast)) {
    return;
  }

  if (!cmpMac(packet->originA, packet->originB)) {
    return;
  }

  if (!cmpMac(packet->originA, origin)) {
    if (packet->length < 0x200) {
      return;
    }

    copyMac(origin, packet->originA);
    reset(true);
  }

  nothing_new = 0;

  if (packet->length >= 0x200 && lastLength - packet->length == 1) {
    guide++;

    if (guide == 3) {
      refLength = packet->length - 0x200;
      guided = true;

      if (nonzero) {
        reset(false);
      }
    }
  } else {
    guide = 0;
  }

  lastLength = packet->length;

  if (!guided || (nonzero > 0 && nonzero == dataBuffer.nonzero)) {
    return;
  }

  const uint16_t realLength = packet->length - refLength;
  const uint16_t lengthZ = realLength - 40;

  if (lengthZ >= 0x200) {
    return;
  }

  if ((lengthY & 0x100) && !(lengthZ & 0x100)) {
    handleUdpData(lengthX, lengthY, lengthZ);
  }

  lengthX = lengthY;
  lengthY = lengthZ;
}
